## buildroot-external/Config.in
```kconfig
menu "PiPhone external"

#  source "package/piphone-agent/Config.in"
#  source "package/piphone-ui/Config.in"
endmenu
```

## buildroot-external/configs/piphone_defconfig
```kconfig
BR2_aarch64=y
BR2_TOOLCHAIN_BUILDROOT_GLIBC=y
BR2_LINUX_KERNEL=y
BR2_LINUX_KERNEL_DTS_SUPPORT=y
BR2_LINUX_KERNEL_INTREE_DTS_NAME="broadcom/bcm2711-rpi-4-b"
BR2_LINUX_KERNEL_CUSTOM_GIT=y
BR2_LINUX_KERNEL_CUSTOM_REPO_URL="https://github.com/raspberrypi/linux.git"
BR2_LINUX_KERNEL_CUSTOM_REPO_VERSION="rpi-6.6.y"
BR2_LINUX_KERNEL_USE_DEFCONFIG=y
BR2_LINUX_KERNEL_DEFCONFIG="bcm2711"
BR2_LINUX_KERNEL_CONFIG_FRAGMENT_FILES="../buildroot-external/linux/fragments/linux-usb.fragment ../buildroot-external/linux/fragments/modem.fragment ../buildroot-external/linux/fragments/uart.fragment"
BR2_KERNEL_HEADERS_6_6=y
BR2_PACKAGE_RPI_FIRMWARE=y
BR2_PACKAGE_RPI_FIRMWARE_VARIANT_PI4=y
BR2_PACKAGE_RPI_FIRMWARE_CMDLINE_FILE="board/raspberrypi/cmdline.txt"
BR2_PACKAGE_RPI_FIRMWARE_CONFIG_FILE="board/raspberrypi/config_4_64bit.txt"
BR2_PACKAGE_HOST_DOSFSTOOLS=y
BR2_PACKAGE_HOST_MTOOLS=y
BR2_PACKAGE_HOST_GENIMAGE=y
BR2_ROOTFS_OVERLAY="../buildroot-external/overlays/rootfs"
BR2_PACKAGE_PYTHON3=y
BR2_PACKAGE_PYTHON_SERIAL=y
BR2_PACKAGE_WPA_SUPPLICANT=y
BR2_PACKAGE_WPA_SUPPLICANT_NL80211=y
BR2_PACKAGE_MINICOM=y
BR2_ROOTFS_POST_IMAGE_SCRIPT="board/raspberrypi/post-image.sh"
BR2_ROOTFS_POST_SCRIPT_ARGS="board/raspberrypi4-64/genimage-raspberrypi4-64.cfg"
BR2_TARGET_ROOTFS_EXT2=y
BR2_TARGET_ROOTFS_EXT2_4=y
BR2_TARGET_ROOTFS_EXT2_SIZE="256M"
```

## buildroot/package/python3-pyserial/Config.in
```kconfig
config BR2_PACKAGE_PYTHON3_PYSERIAL
    bool "python3-pyserial"
    depends on BR2_PACKAGE_PYTHON3
    help
      Python 3 serial module (pyserial)
```
